## sources/meta-system-controller/conf/machine/eval-brd-sc-zynqmp-sdt.conf
```bitbake
#@TYPE: Machine
#@NAME: eval-brd-sc-zynqmp-sdt
#@DESCRIPTION: Machine configuration for the eval-brd-sc-zynqmp-sdt boards.

BBMULTICONFIG += "eval-brd-sc-zynqmp-sdt-cortexa53-fsbl eval-brd-sc-zynqmp-sdt-microblaze-pmu"

#### Preamble
MACHINEOVERRIDES =. "${@['', 'eval-brd-sc-zynqmp-sdt:']['eval-brd-sc-zynqmp-sdt' !='${MACHINE}']}"
#### Regular settings follow
TUNEFILE[microblaze-pmu] = "conf/machine/include/eval-brd-sc-zynqmp-sdt/microblaze.inc"

# First Stage Boot Loader
FSBL_DEPENDS = ""
FSBL_MCDEPENDS = "mc::eval-brd-sc-zynqmp-sdt-cortexa53-fsbl:fsbl-firmware:do_deploy"
FSBL_DEPLOY_DIR = "${TMPDIR}-eval-brd-sc-zynqmp-sdt-cortexa53-fsbl/deploy/images/${MACHINE}"

# PMU Firware
PMU_DEPENDS = ""
PMU_MCDEPENDS = "mc::eval-brd-sc-zynqmp-sdt-microblaze-pmu:pmu-firmware:do_deploy"
PMU_FIRMWARE_DEPLOY_DIR = "${TMPDIR}-eval-brd-sc-zynqmp-sdt-microblaze-pmu/deploy/images/${MACHINE}"

# Set the default (linux) domain device tree
CONFIG_DTFILE_DIR := "${@bb.utils.which(d.getVar('BBPATH'), 'conf/dts/eval-brd-sc-zynqmp-sdt')}"
CONFIG_DTFILE ?= "${CONFIG_DTFILE_DIR}/cortexa53-linux.dts"
CONFIG_DTFILE[vardepsexclude] += "CONFIG_DTFILE_DIR"

# Yocto arm-trusted-firmware(TF-A) variables
ATF_CONSOLE ?= "cadence"
TFA_BL33_LOAD ?= "0x8000000"

# Set DDR Base address for u-boot-xlnx-scr variables
DDR_BASEADDR ?= "0x0"
SKIP_APPEND_BASEADDR ?= "0"

# Yocto KERNEL Variables
UBOOT_ENTRYPOINT  ?= "0x200000"
UBOOT_LOADADDRESS ?= "0x200000"

# Yocto MACHINE_FEATURES Variable
MACHINE_FEATURES += "fpga-overlay mali400"

# Required generic machine inclusion
require conf/machine/system-controller-generic.conf

MACHINEOVERRIDES =. "system-controller:eval-brd-sc-zynqmp:"

# This is an 'SDT' based BSP
XILINX_WITH_ESW = "sdt"

# Original SDT artifacts URL
SDT_URI = "https://petalinux.xilinx.com/sswreleases/rel-v2024.2/sdt/2024.2/2024.2_1111_2_02260716/external/eval-brd-sc-zynqmp-sdt/eval-brd-sc-zynqmp-sdt_2024.2_1111_1.tar.gz"
SDT_URI[sha256sum] = "f3ee31a8f5643a258310743d463845b842940a5b222d162f1dc634735c97d8e8"
SDT_URI[S] = "${WORKDIR}/eval-brd-sc-zynqmp-sdt_2024.2_1111_1/xilinx-versal-system-controller-2024.2_sdt"

# Set the system device trees
SYSTEM_DTFILE_DEPENDS = "sdt-artifacts"
SYSTEM_DTFILE_DIR = "${RECIPE_SYSROOT}${datadir}/sdt/${MACHINE}"
SYSTEM_DTFILE = "${SYSTEM_DTFILE_DIR}/system-top.dts"

# Load the dynamic machine features
include conf/machine/include/eval-brd-sc-zynqmp-sdt/${BB_CURRENT_MC}-features.conf
LIBXIL_CONFIG = "conf/machine/include/eval-brd-sc-zynqmp-sdt/${BB_CURRENT_MC}-libxil.conf"

# Update bootbin to use proper device tree
BIF_PARTITION_IMAGE[device-tree] = "${RECIPE_SYSROOT}/boot/devicetree/${@os.path.basename(d.getVar('CONFIG_DTFILE').replace('.dts', '.dtb'))}"

# Remap boot files to ensure the right device tree is listed first
IMAGE_BOOT_FILES =+ "devicetree/${@os.path.basename(d.getVar('CONFIG_DTFILE').replace('.dts', '.dtb'))}"

#### No additional settings should be after the Postamble
#### Postamble
PACKAGE_EXTRA_ARCHS:append = "${@['', ' eval_brd_sc_zynqmp_sdt']['eval-brd-sc-zynqmp-sdt' != '${MACHINE}']}"
```

## sources/meta-system-controller/conf/machine/eval-brd-sc-zynqmp.conf
```bitbake
#@TYPE: Machine
#@NAME: eval-brd-sc-zynqmp
#@DESCRIPTION: Machine configuration for vkp120, vckp180, vhk158, vek280 system controller.

#### Preamble
MACHINEOVERRIDES =. "${@['', 'eval-brd-sc-zynqmp:']['eval-brd-sc-zynqmp' !='${MACHINE}']}"
#### Regular settings follow

# Yocto device-tree variables
YAML_CONSOLE_DEVICE_CONFIG:pn-device-tree ?= "psu_uart_1"
YAML_MAIN_MEMORY_CONFIG:pn-device-tree ?= "psu_ddr_0"
DT_PADDING_SIZE:pn-device-tree ?= "0x1000"
DTC_FLAGS:pn-device-tree ?= ""
YAML_DT_BOARD_FLAGS ?= "{BOARD zynqmp-sc-revb}"

# Yocto u-boot-xlnx variables
UBOOT_MACHINE ?= "xilinx_zynqmp_virt_defconfig"

# Yocto PMUFW variables
YAML_COMPILER_FLAGS:append:pn-pmu-firmware = " "
YAML_SERIAL_CONSOLE_STDIN:pn-pmu-firmware ?= "psu_uart_1"
YAML_SERIAL_CONSOLE_STDOUT:pn-pmu-firmware ?= "psu_uart_1"

# Yocto FSBL variables
YAML_SERIAL_CONSOLE_STDIN:pn-fsbl-firmware ?= "psu_uart_1"
YAML_SERIAL_CONSOLE_STDOUT:pn-fsbl-firmware ?= "psu_uart_1"

# Serial Console Settings
SERIAL_CONSOLES ?= "115200;ttyPS0"
YAML_SERIAL_CONSOLE_BAUDRATE ?= "115200"

# Yocto arm-trusted-firmware(TF-A) variables
ATF_CONSOLE ?= "cadence1"
TFA_BL33_LOAD ?= "0x8000000"

# Set DDR Base address for u-boot-xlnx-scr variables
DDR_BASEADDR ?= "0x0"
SKIP_APPEND_BASEADDR ?= "0"

# Yocto KERNEL Variables
UBOOT_ENTRYPOINT  ?= "0x200000"
UBOOT_LOADADDRESS ?= "0x200000"

# Yocto MACHINE_FEATURES Variable
MACHINE_FEATURES += "fpga-overlay mali400"

# Yocto uboot device-tree variables
YAML_CONSOLE_DEVICE_CONFIG:pn-uboot-device-tree ?= "psu_uart_1"

# Required generic machine inclusion
require conf/machine/system-controller-generic.conf

# Add the following files to /boot
IMAGE_BOOT_FILES += "system-sc-revc-zynqmp.dtb system.dtb"
WKS_FILES = "system-controller-nobootpartition.wks"

# enable RAUC_DEMO for this board by default
SYSTEM_CONTROLLER_RAUC_DEMO = "yes"

# This is an 'XSCT' based BSP
XILINX_XSCT_VERSION = "2024.2"
XILINX_WITH_ESW = "xsct"

# Add system XSA
HDF_URI = "https://petalinux.xilinx.com/sswreleases/rel-v2024.2/hdf-examples/2024.2/2024.2_1111_1_02260501/external/eval-brd-sc/eval-brd-sc-2024.2_1111_1.xsa"
HDF_URI[sha256sum] = "642ae4b7ddff6fbb59e5cd92662933008dd67ecef4b61ddea7ed95cea412c84e"

#### No additional settings should be after the Postamble
#### Postamble
PACKAGE_EXTRA_ARCHS:append = "${@['', ' eval_brd_sc_zynqmp']['eval-brd-sc-zynqmp' != '${MACHINE}']}"
```

## sources/meta-system-controller/conf/machine/include/eval-brd-sc-zynqmp-sdt/eval-brd-sc-zynqmp-sdt-microblaze-pmu-features.conf
```bitbake
MACHINE_FEATURES = "axipmon clockps common csudma ddrcpsu emacps gpiops iicps ipipsu qspipsu resetps rtcpsu sdps sysmonpsu ttcps uartps zdma"
```

## sources/meta-system-controller/conf/machine/include/vck-sc-zynqmp-sdt/vck-sc-zynqmp-sdt-cortexa53-fsbl-features.conf
```bitbake
MACHINE_FEATURES = "axipmon clockps common coresightps-dcc csudma ddrcpsu emacps gpiops iic iicps ipipsu resetps rtcpsu scugic sdps sysmonpsu uartps zdma"
```

## sources/meta-system-controller/conf/machine/include/vck-sc-zynqmp-sdt/vck-sc-zynqmp-sdt-microblaze-pmu-features.conf
```bitbake
MACHINE_FEATURES = "axipmon clockps common csudma ddrcpsu emacps gpiops iic iicps ipipsu resetps rtcpsu sdps sysmonpsu uartps zdma"
```

## sources/meta-system-controller/conf/machine/vck-sc-zynqmp.conf
```bitbake
#@TYPE: Machine
#@NAME: vck-sc-zynqmp
#@DESCRIPTION: Machine configuration for vck190 and vmk180 system controller.

#### Preamble
MACHINEOVERRIDES =. "${@['', 'vck-sc-zynqmp:']['vck-sc-zynqmp' !='${MACHINE}']}"
#### Regular settings follow

# Yocto device-tree variables
YAML_CONSOLE_DEVICE_CONFIG:pn-device-tree ?= "psu_uart_0"
YAML_MAIN_MEMORY_CONFIG:pn-device-tree ?= "psu_ddr_0"
DT_PADDING_SIZE:pn-device-tree ?= "0x1000"
DTC_FLAGS:pn-device-tree ?= ""
YAML_DT_BOARD_FLAGS ?= "{BOARD zynqmp-e-a2197-00-revb}"

# Yocto u-boot-xlnx variables
UBOOT_MACHINE ?= "xilinx_zynqmp_virt_defconfig"

# Yocto PMUFW variables
YAML_COMPILER_FLAGS:append:pn-pmu-firmware = " "
YAML_SERIAL_CONSOLE_STDIN:pn-pmu-firmware ?= "psu_uart_0"
YAML_SERIAL_CONSOLE_STDOUT:pn-pmu-firmware ?= "psu_uart_0"

# Yocto FSBL variables
YAML_SERIAL_CONSOLE_STDIN:pn-fsbl-firmware ?= "psu_uart_0"
YAML_SERIAL_CONSOLE_STDOUT:pn-fsbl-firmware ?= "psu_uart_0"

# Serial Console Settings
SERIAL_CONSOLES ?= "115200;ttyPS0"
YAML_SERIAL_CONSOLE_BAUDRATE ?= "115200"

# Yocto arm-trusted-firmware(TF-A) variables
ATF_CONSOLE ?= "cadence"
TFA_BL33_LOAD ?= "0x8000000"

# Set DDR Base address for u-boot-xlnx-scr variables
DDR_BASEADDR ?= "0x0"
SKIP_APPEND_BASEADDR ?= "0"

# Yocto KERNEL Variables
UBOOT_ENTRYPOINT  ?= "0x200000"
UBOOT_LOADADDRESS ?= "0x200000"

# Yocto MACHINE_FEATURES Variable
MACHINE_FEATURES += "mali400"

# Required generic machine inclusion
require conf/machine/system-controller-generic.conf

# Add the following files to pack in wic FAT partition
IMAGE_BOOT_FILES += "boot.bin system.dtb"
# Pack bitstream in BOOT.BIN for vck-sc-zynqmp
BIF_BITSTREAM_ATTR  = "bitstream"

# This is an 'XSCT' based BSP
XILINX_XSCT_VERSION = "2024.2"
XILINX_WITH_ESW = "xsct"

# Add system XSA
HDF_URI = "https://petalinux.xilinx.com/sswreleases/rel-v2024.2/hdf-examples/2024.2/2024.2_1111_1_02260501/external/vck-sc-zynqmp/vck-sc-zynqmp-2024.2_1111_1.xsa"
HDF_URI[sha256sum] = "4542dc12ed0d155578901ebcd97a0f671edf75ddf315ad2a8d8eda626920ff8d"

#### No additional settings should be after the Postamble
#### Postamble
PACKAGE_EXTRA_ARCHS:append = "${@['', ' vck_sc_zynqmp']['vck-sc-zynqmp' != '${MACHINE}']}"
```
